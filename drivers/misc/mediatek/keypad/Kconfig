## drivers/misc/mediatek/keypad/Kconfig
```kconfig
config MTK_KEYPAD
	tristate "MediaTek Keypad Support"
	---help---
	  Say Y here if you want to use the keypad.
	  To compile this driver as a module, choose M here: the
	  module will be called mtk-kpd.

config KEYBOARD_HID
	tristate "MediaTek hid keyboard support"
	---help---
	  Say Y here if you want to use the hid keyboard.
	  To compile this driver as a module, choose M here: the
	  module will be called hid_keyboard.

config ONEKEY_REBOOT_NORMAL_MODE
	bool "Long press reboot by Powerkey only on normal mode"
	default n
```
